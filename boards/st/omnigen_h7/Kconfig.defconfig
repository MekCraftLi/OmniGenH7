## boards/st/omnigen_h7/Kconfig.omnigen_h7
```kconfig
config BOARD_OMNIGEN_H7
   select SOC_STM32H723XX
   select USE_STM32_HAL_DAC
   select USE_STM32_HAL_DAC_EX
   select USE_STM32_HAL_DMA
   select USE_STM32_HAL_GPIO
   select USE_STM32_HAL_TIM
   select USE_STM32_HAL_TIM_EX
```

## boards/st/omnigen_h7/board.yml
```yaml
board:
  name: omnigen_h7
  full_name: OmniGen H7
  vendor: st
  socs:
    - name: stm32h723xx
```

## boards/st/omnigen_h7/omnigen_h7_defconfig
```kconfig
CONFIG_ARM_MPU=y
CONFIG_HW_STACK_PROTECTION=y
CONFIG_SERIAL=y
CONFIG_CONSOLE=y
CONFIG_UART_CONSOLE=y
CONFIG_GPIO=y

# prj.conf
CONFIG_SERIAL=y
CONFIG_UART_ASYNC_API=y
CONFIG_DMA=y

CONFIG_UART_STM32=y
```
